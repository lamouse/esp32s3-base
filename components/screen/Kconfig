## components/screen/Kconfig
```kconfig
menu "screen Configuration"

    config LCD_H_RES
        int "LCD horizontal resolution"
        default 320
        help
            "This is the horizontal resolution of the LCD."

    config LCD_V_RES
        int "LCD vertical resolution"
        default 240
        help
            "This is the vertical resolution of the LCD."

    config LCD_CMD_BITS
        int "LCD command bits"
        default 8
        help
            "This is the number of bits used to send commands to the LCD."

    config LCD_PARAM_BITS
        int "LCD parameter bits"
        default 8
        help
            "This is the number of bits used to send parameters to the LCD."

    config LCD_BITS_PER_PIXEL
        int "LCD  Color depth, in bpp"
        default 16
        help
            "LCD  Color depth, in bpp"
    config LCD_SWAP_XY
        bool "swap lcd xy"
        default 1
        help
            "swap lcd xy"

endmenu
```

## components/wifi/Kconfig
```kconfig
menu "wifi Configuration"

    config WIFI_SCAN_LIST_SIZE
        int "Max size of scan list"
        range 0 20
        default 10
        help
            The size of array that will be used to retrieve the list of access points.

    config WIFI_USE_SCAN_CHANNEL_BITMAP
        bool "Scan only non overlapping channels using Channel bitmap"
        default 0
        help
            Enable this to scan only the non overlapping channels i.e 1,6,11 by mentioning a channel bitmap
            in scan config. If you wish to scan a different set of specific channels, please edit the channel_list
            array in scan.c. Channels for a 2.4 ghz network range should range from 1-14.
    config AP_MODE
        bool "Enable WiFi Access Point Mode"
        default 0
        help
            Enable this to run ESP32 as WiFi Access Point. If enabled, the ESP32 will create a WiFi network with the SSID and password specified in AP_MODE_SSID and AP_MODE_PASSWORD.
    config AP_MODE_SSID
        depends on AP_MODE
        string "WiFi SSID"
        default "esp32-s3"
        help
            The SSID of the ESP32 WiFi Access Point.
    config AP_MODE_PASSWORD
        depends on AP_MODE
        string "WiFi Password"
        default "123456789"
        help
            The password of the ESP32 WiFi Access Point.
    config AP_MODE_CHANNEL
        depends on AP_MODE
        int "Default ap channel"
        range 1 13
        default 1
        help 
            "Channel to use for the ESP32 WiFi Access Point."
    config AP_MODE_MAX_CONNECTIONS
        depends on AP_MODE
        int "Default max connections"
        range 1 8
        default 4
        help 
            "Maximum number of connections allowed for the ESP32 WiFi Access Point."    

endmenu
```
